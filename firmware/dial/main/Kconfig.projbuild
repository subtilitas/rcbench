## firmware/dial/main/Kconfig.projbuild
```kconfig
menu "rcbench Dial"

    choice RCBENCH_DIAL_BOARD
        prompt "Board"
        default RCBENCH_DIAL_BOARD_M5DIAL
        help
            The board the Dial image runs on: its pins, its INFO hardware
            value and its update kind (main/dial_board.h).  The K518 build
            is sdkconfig.k518 appended to sdkconfig.defaults.

        config RCBENCH_DIAL_BOARD_M5DIAL
            bool "M5Stack Dial v1.1"
        config RCBENCH_DIAL_BOARD_K518
            bool "Guition JC3636K518C knob"
    endchoice

endmenu
```

## firmware/node/main/Kconfig.projbuild
```kconfig
menu "rcbench node"

    choice RCNODE_ROLE
        prompt "Role"
        default RCNODE_ROLE_POWER
        help
            The sensor this image drives.  A board is wired for one role, so
            the role is a property of the image, not a stored setting.

        config RCNODE_ROLE_POWER
            bool "Power: the INA228 on the ESC's XT60 power path"
        config RCNODE_ROLE_BALANCE
            bool "Balance: an accelerometer axis and an index sensor"
        config RCNODE_ROLE_SERVO
            bool "Servo: the remote servo node's ES3C28P, the link to its Core2350B"
            depends on IDF_TARGET_ESP32S3
    endchoice

    choice RCNODE_BOARD
        prompt "Board"
        default RCNODE_BOARD_ES3C28P if IDF_TARGET_ESP32S3
        default RCNODE_BOARD_C6_ZERO
        help
            The board the image runs on: its pins and its update kind
            (main/node_board.h).

        config RCNODE_BOARD_C6_ZERO
            bool "Waveshare ESP32-C6-Zero"
            depends on IDF_TARGET_ESP32C6
        config RCNODE_BOARD_ES3C28P
            bool "LCDWIKI ES3C28P: 2.8in ESP32-S3 display board, power or servo role"
            depends on IDF_TARGET_ESP32S3 && (RCNODE_ROLE_POWER || RCNODE_ROLE_SERVO)
    endchoice

endmenu
```
