## firmware/node/main/Kconfig.projbuild
```kconfig
menu "rcbench node"

    choice RCNODE_ROLE
        prompt "Role"
        default RCNODE_ROLE_POWER
        help
            The sensor this image drives.  A board is wired for one role, so
            the role is a property of the image, not a stored setting.

        config RCNODE_ROLE_POWER
            bool "Power: the INA228 on the ESC's XT60 power path"
        config RCNODE_ROLE_BALANCE
            bool "Balance: vibration and index sensors (stub)"
    endchoice

endmenu
```

## firmware/p4test/main/Kconfig.projbuild
```kconfig
menu "rcbench P4 bring-up test"

choice P4TEST_BOARD
    prompt "Board and display"
    default P4TEST_BOARD_WIFI6_HOSYOND7
    help
        The hardware the test runs on.  Each choice fixes the display's
        I2C (Inter-Integrated Circuit) pins, its timings and the touch
        controller.

config P4TEST_BOARD_WIFI6_HOSYOND7
    bool "Waveshare ESP32-P4-WIFI6 + Hosyond 7in 800x480 DSI"
endchoice

endmenu
```
