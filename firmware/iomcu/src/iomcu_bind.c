/*
 * The binding prepared and taken whole (BIND, BIND_CFG, BIND_OUT), and the
 * board's own pages: CATALOGUE, SHAPE, ARTWORK, ART_DATA and PADS; see
 * iomcu.h for the other files.
 *
 * SPDX-License-Identifier: MIT
 */
#include <string.h>

#include "iomcu.h"

#include "iomcu_pins.h"
#include "link_artxfer.h"
#include "out_bind.h"
#include "out_stage.h"

/* ---------------------------------------------------------------- BIND */

/*
 * A binding prepared and taken whole (protocol 4.10): BIND_CFG and BIND_OUT
 * hold a CHAN_CFG and an OUTPUTS page that are not in force, and a write of
 * BIND's COMMIT that names their CRC (cyclic redundancy check) puts both in
 * force or neither.  shared/outputs/out_stage.c decides; this is the glue
 * to the two pages' own rules in iomcu_pages.c.  Not kept in flash: it starts as the
 * pages in force at boot.
 */
out_stage_t s_stage;
/* The slots the silicon had bound when a commit began, put back with the
 * CHAN_CFG page when the commit's OUTPUTS page is refused. */
static uint8_t s_stage_bound;

void bind_cfg_read(void *ctx, uint8_t off, uint8_t n, uint16_t *out)
{
    (void)ctx;
    out_stage_cfg_read(&s_stage, off, n, out);
}

uint8_t bind_cfg_write(void *ctx, uint8_t off, uint8_t n,
                              const uint16_t *in)
{
    (void)ctx;
    return out_stage_cfg_write(&s_stage, off, n, in);
}

void bind_out_read(void *ctx, uint8_t off, uint8_t n, uint16_t *out)
{
    (void)ctx;
    out_stage_slots_read(&s_stage, off, n, out);
}

uint8_t bind_out_write(void *ctx, uint8_t off, uint8_t n,
                              const uint16_t *in)
{
    (void)ctx;
    return out_stage_slots_write(&s_stage, off, n, in);
}

static uint8_t stage_take_cfg(void *ctx, const uint16_t *next)
{
    s_stage_bound = bound_slots();
    return chan_cfg_take((iomcu_state_t *)ctx, next, s_stage.slots, false);
}

static uint8_t stage_take_slots(void *ctx, const uint16_t *next)
{
    return slots_take((iomcu_state_t *)ctx, next, false);
}

static void stage_put_cfg(void *ctx, const uint16_t *prev)
{
    /* The commit has put the bank's channels back, each command with its
     * role; the page and the silicon follow it here. */
    iomcu_state_t *s = (iomcu_state_t *)ctx;
    memcpy(s->chan_cfg, prev, sizeof(s->chan_cfg));
    hw_apply_only(s_stage_bound);
}

static void stage_keep(void *ctx)
{
    save_outputs((const iomcu_state_t *)ctx);
}

static const out_stage_ops_t k_stage_ops = {
    stage_take_cfg, stage_take_slots, stage_put_cfg, stage_keep, &s_outputs,
};

void bind_read(void *ctx, uint8_t off, uint8_t n, uint16_t *out)
{
    (void)ctx;
    for (uint8_t i = 0; i < n; ++i) {
        out[i] = ((uint8_t)(off + i) == (uint8_t)LINK_BD_COMMIT)
                     ? out_stage_held_crc(&s_stage) : 0u;
    }
}

uint8_t bind_write(void *ctx, uint8_t off, uint8_t n,
                          const uint16_t *in)
{
    iomcu_state_t *s = (iomcu_state_t *)ctx;
    if (off != (uint8_t)LINK_BD_COMMIT || n != 1u) {
        return LINK_NACK_BAD_RANGE;
    }
    return out_stage_commit(&s_stage, in[0], s->chan_cfg, &k_stage_ops, s);
}

/*
 * This board's own pins, so a panel that has never heard of it can still
 * offer the right ones.
 *
 * Rendered on demand rather than held: the catalogue is const and the page
 * is read once at link-up, so a cached copy would be thirty-two registers of
 * RAM to save a loop that runs once.
 *
 * Saying a pin is free here does not make it free.  outputs_reserve_pins()
 * has already been given the union of this catalogue and the pins this
 * application assigns, and refuses the rest whatever the page says -- so a
 * catalogue that is wrong costs a pin rather than the safety line.
 */
void catalogue_read(void *ctx, uint8_t off, uint8_t n, uint16_t *out)
{
    (void)ctx;
    uint16_t all[LINK_CAT_COUNT];
    outbind_board_to_regs(outbind_board(IOMCU_BOARD_ID), all);
    for (uint8_t i = 0; i < n; ++i) {
        out[i] = all[off + i];
    }
}

/*
 * And where those pins are, so a panel that has never seen this board can
 * draw it rather than only list it.  Zeroes when the build has no shape for
 * the board, which the panel reads as "not drawable" and nothing worse.
 */
void shape_read(void *ctx, uint8_t off, uint8_t n, uint16_t *out)
{
    (void)ctx;
    uint16_t all[LINK_SH_COUNT];
    outbind_shape_to_regs(outbind_board(IOMCU_BOARD_ID), all);
    for (uint8_t i = 0; i < n; ++i) {
        out[i] = all[off + i];
    }
}

/*
 * The drawing of this board: its outline, its parts as flat shapes and
 * every pad with what it is, LINK_ART_DRAWING as link_pages.h lays it out.
 *
 * Generated by tools/gen_board_drawing.py from the configurator's panel
 * drawing (configurator/drawings/panel.json) and checked in, so this build
 * needs no Python and no Node.js.  A const array in this binary: no erase
 * window, no wear, and its version is the firmware version.  A new board
 * brings its own drawing here with its own catalogue.
 *
 * A build carrying no drawing answers LINK_AW_BLOCKS of zero, which is the
 * ordinary reply and not a fault: the panel then draws the board from its
 * shape page instead.
 */
extern const uint8_t  board_drawing_rp2350_can[];
extern const uint16_t board_drawing_rp2350_can_width;
extern const uint16_t board_drawing_rp2350_can_height;
extern const uint32_t board_drawing_rp2350_can_bytes;
extern const uint16_t board_drawing_rp2350_can_crc;
extern const uint32_t board_drawing_rp2350_can_hash;

void artwork_read(void *ctx, uint8_t off, uint8_t n, uint16_t *out)
{
    (void)ctx;
    uint16_t all[LINK_AW_COUNT];
    link_artserve_meta(all, (uint16_t)LINK_ART_DRAWING,
                       board_drawing_rp2350_can_width,
                       board_drawing_rp2350_can_height,
                       board_drawing_rp2350_can_bytes,
                       board_drawing_rp2350_can_crc,
                       board_drawing_rp2350_can_hash);
    for (uint8_t i = 0; i < n; ++i) {
        out[i] = all[off + i];
    }
}

/*
 * Which block the data page is answering with.  Held here because the host
 * says it in one transaction and reads it in the next: a block that advanced
 * on being read would resend nothing after a reply went missing, and the
 * panel would assemble a drawing with a hole in it.
 */
static uint16_t s_art_block;

void art_data_read(void *ctx, uint8_t off, uint8_t n, uint16_t *out)
{
    (void)ctx;
    uint16_t all[LINK_AD_COUNT];
    link_artserve_block(all, board_drawing_rp2350_can,
                        board_drawing_rp2350_can_bytes, s_art_block);
    for (uint8_t i = 0; i < n; ++i) {
        out[i] = all[off + i];
    }
}

uint8_t art_data_write(void *ctx, uint8_t off, uint8_t n,
                              const uint16_t *in)
{
    (void)ctx;
    /* Only the block register is writable; the payload is this board's. */
    if (off != LINK_AD_BLOCK || n != 1u) {
        return (uint8_t)LINK_NACK_READ_ONLY;
    }
    s_art_block = in[0];
    return 0u;
}

/*
 * And which pads are grounds and rails, so a servo lead's other two wires
 * can be found on the screen instead of by counting pads on the board.
 */
void pads_read(void *ctx, uint8_t off, uint8_t n, uint16_t *out)
{
    (void)ctx;
    uint16_t all[LINK_PAD_COUNT];
    outbind_pads_to_regs(outbind_board(IOMCU_BOARD_ID), all);
    for (uint8_t i = 0; i < n; ++i) {
        out[i] = all[off + i];
    }
}
